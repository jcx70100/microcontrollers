/*******************************************************************************  
* 文件名称：LED流水灯控制实验
* 实验目的：掌握单片机IO口操作的基本方法
* 程序说明： J13选择IO， 
* 日期版本：2015-8
//此种方法能够熟悉开发板上面各个芯片的使用方法  程序可读性更强，方便初学者入手

*******************************************************************************/

#include "reg52.h"  //定义51单片机特殊功能寄存器
#include "intrins.h"

sbit  HC138A = P2^5;
sbit  HC138B = P2^6;
sbit  HC138C = P2^7;

//延时函数 软件延时
void delay(int ms) //10ms一次
{
    unsigned char i,j;
    for(i=0; i<220; i++)
    {
        for(j=0; j<ms; j++)
        {
            ;
        }
    } 
}
void U6suocun(void) //LED对应锁存器U6控制端LE 从高位变为低位
{
   HC138A = 0;
   HC138B = 0;
   HC138C = 1; //Y4 为0  其他为高
   _nop_();
   _nop_();
   HC138A = 0;
   HC138B = 0;
   HC138C = 0; //Y4 为1 （此时只有Y0是0 不过Y0在板子上没有用到）
  
}

//主函数
void main(void)
{
    unsigned char i;
	//把要显示的方式写成数组，可以实现花样流水灯
	char temp[9] = {0x00,0x01,0x03,0x07,0x0f,0x1f,0x3f,0x7f,0xff}; //把要点亮的方式写成数组
	HC138A = 0;
    HC138B = 0;
    HC138C = 0; //初始化 
    i=0;
	while(1)
    {
		P0 = temp[i%9];
		U6suocun();
		delay(100);
		i++;
    }
}